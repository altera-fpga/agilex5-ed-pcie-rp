// SPDX-License-Identifier:     GPL-2.0
/*
 * Copyright (C) 2026 Altera Corporation
 *
 * PCIe Root Port on the Agilex 5 E-Series 065B Modular Development Kit.
 * socfpga_agilex5_pcie_root_port.dtsi comes from
 * 0002-arm64-dts-agilex5-Add-dtsi-for-PCIe-Root-Port.patch.
 */
#include "socfpga_agilex5_socdk_modular.dts"
#include "socfpga_agilex5_pcie_root_port.dtsi"

&pcie_0_pcie_aglx {
	status = "okay";
};

&pcie_0_msi_irq {
	status = "okay";
};
